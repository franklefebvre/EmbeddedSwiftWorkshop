## Code/08-Bluetooth-Peripheral/sdkconfig.defaults
```kconfig
CONFIG_BT_ENABLED=y
CONFIG_BT_NIMBLE_ENABLED=y
CONFIG_BT_NIMBLE_50_FEATURE_SUPPORT=n

CONFIG_ESP_TIMER_SUPPORTS_ISR_DISPATCH_METHOD=y
```
